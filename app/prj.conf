## Kconfig
```
# Application Kconfig

mainmenu "Zephyr Application Configuration"

# Source Zephyr's Kconfig
source "Kconfig.zephyr"

# Add application-specific Kconfig options below
menu "Application Configuration"

config APP_CUSTOM_OPTION
	bool "Enable custom application option"
	default n
	help
	  This is an example custom configuration option.
	  Enable this to activate custom application features.

if APP_CUSTOM_OPTION

config APP_CUSTOM_VALUE
	int "Custom value"
	default 42
	range 0 100
	help
	  Example integer configuration value.

endif # APP_CUSTOM_OPTION

endmenu
```

## prj.conf
```kconfig
# Zephyr Application Configuration

# Enable console and logging
CONFIG_CONSOLE=y
CONFIG_UART_CONSOLE=y
CONFIG_LOG=y
CONFIG_LOG_DEFAULT_LEVEL=3

# Enable serial driver
CONFIG_SERIAL=y

# Add your application-specific configurations below
# Example:
# CONFIG_GPIO=y
# CONFIG_I2C=y
# CONFIG_SPI=y
```

## src/main.c
```c
/*
 * Copyright (c) 2024
 * SPDX-License-Identifier: Apache-2.0
 */

#include <zephyr/kernel.h>
#include <zephyr/logging/log.h>

LOG_MODULE_REGISTER(main, LOG_LEVEL_INF);

int main(void)
{
	LOG_INF("Zephyr T3 Forest Template Application Started!");
	LOG_INF("Board: %s", CONFIG_BOARD);
	LOG_INF("Zephyr version: %s", KERNEL_VERSION_STRING);

	uint32_t count = 0;

	while (1) {
		LOG_INF("Hello World! Count: %u", count++);
		k_sleep(K_SECONDS(2));
	}

	return 0;
}
```
